/*
Settings under 'Tools' tab are as follows:
Board: ESP32 Dev Module
Upload Speed: 921600
CPU Frequency: 240MHz (WiFi/BT)
Flash Frequency: 80MHz
Flash Mode: QIO
Flash Size: 4MB (32Mb)
Partition Scheme: Huge APP (3MB No OTA/1MB SPIFFS)
Core Debug Level: Warn
PSRAM: Disabled
Port: Select accordingly
*/

#define BLUETOOTHNAME "⠀DN 1"

#include <Wire.h>
#include <Adafruit_GFX.h>
#include <Adafruit_SSD1306.h>
#include <Adafruit_MPU6050.h>
#include <Adafruit_Sensor.h>
#include <BH1750.h>
#include <Adafruit_AHT10.h>

#define OLED_WIDTH 128
#define OLED_HEIGHT 64
#define Touch0_Pin 27
#define Touch1_Pin 33
#define Touch0_Threshold 15
#define Touch1_Threshold 8
#define PwrLED_Pin 26

#define OLED_ADDR 0x3C
#define BH1750_ADDR 0x23
#define SR04_ADDR 0x57
#define AHT10_ADDR 0x38
#define MPU6050_ADDR 0x68

//OLED Peripherals
Adafruit_SSD1306 display(OLED_WIDTH, OLED_HEIGHT);
byte error, address;
int cursorY=0;

//HC-SR04 Peripherals
byte ds[3];
unsigned long distance=0;
int SR04_buf;

//BH1750 Peripherals
BH1750 lightMeter;
float lux;

//AHT10 Peripherals
Adafruit_AHT10 aht;
sensors_event_t humidity, temp1;

//MPU6050 Peripherals
Adafruit_MPU6050 mpu;
sensors_event_t a, g, temp2;

//Capacitive Touch Peripherals
int Touch0;
int Touch1;
int Touch0_Flag=0;
int Touch1_Flag=0;

int sensorCount=0;
int sensorInit_Fail=0;
int OLED_ConnectFlag=0;
int BH1750_ConnectFlag=0;
int SR04_ConnectFlag=0;
int AHT10_ConnectFlag=0;
int MPU6050_ConnectFlag=0;

const unsigned char myBitmap [] PROGMEM = {
	0xff, 0xff, 0xff, 0xff, 0xff, 0xff, 0xff, 0xff, 0xf8, 0x1f, 0xff, 0xff, 0xff, 0xff, 0xff, 0xff, 
	0xff, 0xff, 0xff, 0xff, 0xff, 0xff, 0xff, 0xff, 0xf0, 0x07, 0xff, 0xff, 0xff, 0xff, 0xff, 0xff, 
	0xff, 0xff, 0xff, 0xff, 0xff, 0xff, 0xff, 0xff, 0xf0, 0x07, 0xff, 0xff, 0xff, 0xff, 0xff, 0xff, 
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	0xff, 0xff, 0xff, 0xff, 0xff, 0x07, 0xff, 0xff, 0xff, 0xff, 0xff, 0xff, 0xff, 0xff, 0xff, 0xff
};

void setup(void) {
  Serial.begin(115200);
  delay(50);
  BluetoothSetup();
  BuzzerSetup();
  pinMode(PwrLED_Pin, OUTPUT);
  digitalWrite(PwrLED_Pin, HIGH);

  Wire.begin();
  delay(50);
  for(address=1; address<127; address++) {
    Wire.beginTransmission(address);
    error=Wire.endTransmission();
    if(error==0) {
      if(address==OLED_ADDR) {
        OLED_ConnectFlag=1;
      }else if(address==BH1750_ADDR) {
        BH1750_ConnectFlag=1;
      }else if(address==SR04_ADDR) {
        SR04_ConnectFlag=1;
      }else if(address==AHT10_ADDR) {
        AHT10_ConnectFlag=1;
      }else if(address==MPU6050_ADDR) {
        MPU6050_ConnectFlag=1;
      }
      sensorCount++;
      delay(10);
    }else if(error==4) {
      sensorInit_Fail=1;
    }
  }

  if(SR04_ConnectFlag==1) {
    ds[0]=0;
    ds[1]=0;
    ds[2]=0;
  }

  if(BH1750_ConnectFlag==1) {
    lightMeter.begin();
  }

  if(AHT10_ConnectFlag==1) {
    aht.begin();
  }
  
  if(MPU6050_ConnectFlag==1) {
    mpu.begin();
    delay(50);
    mpu.setAccelerometerRange(MPU6050_RANGE_8_G);
    mpu.setGyroRange(MPU6050_RANGE_500_DEG);
    mpu.setFilterBandwidth(MPU6050_BAND_5_HZ);
  }

  if(OLED_ConnectFlag==1) {
    display.begin(SSD1306_SWITCHCAPVCC, OLED_ADDR);
    delay(50);

    display.clearDisplay();
    display.drawBitmap(0, 0, myBitmap, 128, 64, BLACK, WHITE);
    delay(50);
    display.display();
    delay(2000);
    display.clearDisplay();

    display.setTextSize(1);
    display.setTextColor(WHITE);
    display.setCursor(0, 0);
    display.println("Hello, world!");
    display.setCursor(0, 10);
    display.println("StickEm' is fun!");
    display.setCursor(80, 55);
    display.print("v3.3b3.3");
    display.setCursor(0, 20);
    display.print("Initializing");
    display.display();
    for(int i=0; i<3; i++) {
      delay(500);
      display.print("...");
      display.display();
    }
    delay(800);

    if(sensorInit_Fail==0) {
      sensorCount--;
      if(sensorCount==0||sensorCount==1) {
        display.setCursor(0, 30);
        display.print(sensorCount);
        display.print(" sensor detected!");
      }else if(sensorCount>=2) {
        display.setCursor(0, 30);
        display.print(sensorCount);
        display.print(" sensors detected!");
      }else {
        display.setCursor(0, 30);
        display.print("No sensors detected!");
      }
    }else {
      display.setCursor(0, 30);
      display.print("Failed, reset uC!");
    }

    display.display();
    delay(1500);
    display.clearDisplay();
    display.display();
  }else {
    if(sensorCount==0||sensorCount==1) {
      Serial.print(sensorCount);
      Serial.println(" sensor detected!");
      delay(1500);
    }else if (sensorCount>=2) {
      Serial.print(sensorCount);
      Serial.println(" sensors detected!");
      delay(1500);
    }else {
      Serial.println("Error!");
      delay(1500);
    }
  }
}

void loop(void) {
  if(OLED_ConnectFlag==1) {
    display.clearDisplay();
    if(SR04_ConnectFlag==1) {
      Wire.beginTransmission(SR04_ADDR);
      Wire.write(1);
      Wire.endTransmission();
      delay(200); //1 cycle approx. 100mS.
      SR04_buf=0;
      Wire.requestFrom(SR04_ADDR,3); //read distance       
      while (Wire.available()) {
        ds[SR04_buf++] = Wire.read();
      }

      distance = (unsigned long)(ds[0]) * 65536;
      distance = distance + (unsigned long)(ds[1]) * 256;
      distance = (distance + (unsigned long)(ds[2])) / 10000;
      if(distance>=900) {
        distance=0;
      }

      display.setTextSize(1);
      display.setTextColor(WHITE);
      display.setCursor(0, cursorY);
      display.print("Distance:");
      display.print(distance);
      display.print("cm");
      cursorY+=10;
    }
    
    if(BH1750_ConnectFlag==1) {
      lux = lightMeter.readLightLevel();
      display.setCursor(0, cursorY);
      display.print("Light:");
      display.print(lux);
      display.print("Lux");
      cursorY+=10;
    }

    if(AHT10_ConnectFlag==1) {
      aht.getEvent(&humidity, &temp1);
      display.setCursor(0, cursorY);
      display.print("Temperature:");
      display.print(temp1.temperature);
      display.print((char)247);
      display.print("C");
      cursorY+=10;
      display.setCursor(0, cursorY);
      display.print("Humidity:");
      display.print(humidity.relative_humidity);
      display.print("%rH");
      cursorY+=10;
    }

    if(MPU6050_ConnectFlag==1) {
      mpu.getEvent(&a, &g, &temp2);
      display.setCursor(0, cursorY);
      display.print("Acc Z:");
      display.print(a.acceleration.z/9.8);
      display.print("G");
      cursorY+=10;
    }

    //Touch Sensing
    Touch0=touchRead(Touch0_Pin);
    Touch1=touchRead(Touch1_Pin);
    if(Touch0<=Touch0_Threshold) {
      Touch0_Flag=1;
      display.setCursor(0, cursorY);
      display.print("Touch1:1");
    }else {
      Touch0_Flag=0;
      display.setCursor(0, cursorY);
      display.print("Touch1:0");
    }
    if(Touch1<=Touch1_Threshold) {
      Touch1_Flag=1;
      display.print(" Touch2:1");
    }else {
      Touch1_Flag=0;
      display.print(" Touch2:0");
    }

    display.display();
    cursorY=0;
    if(SR04_ConnectFlag==0) {
      delay(200);
    }
  }else {
    if(SR04_ConnectFlag==1) {
      Wire.beginTransmission(SR04_ADDR);
      Wire.write(1);
      Wire.endTransmission();
      delay(200); //1 cycle approx. 100mS.
      SR04_buf=0;
      Wire.requestFrom(SR04_ADDR,3); //read distance       
      while (Wire.available()) {
        ds[SR04_buf++] = Wire.read();
      }

      distance = (unsigned long)(ds[0]) * 65536;
      distance = distance + (unsigned long)(ds[1]) * 256;
      distance = (distance + (unsigned long)(ds[2])) / 10000;
      if(distance>=900) {
        distance=0;
      }

      Serial.print("Distance:");
      Serial.print(distance);
      Serial.println("cm");
    }
    
    if(BH1750_ConnectFlag==1) {
      lux = lightMeter.readLightLevel();
      Serial.print("Light:");
      Serial.print(lux);
      Serial.println("Lux");
    }

    if(AHT10_ConnectFlag==1) {
      aht.getEvent(&humidity, &temp1);
      Serial.print("Temperature:");
      Serial.print(temp1.temperature);
      Serial.print("degrees");
      Serial.print(" Humidity:");
      Serial.print(humidity.relative_humidity);
      Serial.println("%rH");
    }

    if(MPU6050_ConnectFlag==1) {
      mpu.getEvent(&a, &g, &temp2);
      Serial.print("Acceleration X: ");
      Serial.print(a.acceleration.x);
      Serial.print(", Y: ");
      Serial.print(a.acceleration.y);
      Serial.print(", Z: ");
      Serial.print(a.acceleration.z);
      Serial.println(" m/s^2");
      Serial.print("Rotation X: ");
      Serial.print(g.gyro.x);
      Serial.print(", Y: ");
      Serial.print(g.gyro.y);
      Serial.print(", Z: ");
      Serial.print(g.gyro.z);
      Serial.println(" rad/s");
      Serial.print("Temperature: ");
      Serial.print(temp2.temperature);
      Serial.println(" degree");
    }

    //Touch Sensing
    Touch0=touchRead(Touch0_Pin);
    Touch1=touchRead(Touch1_Pin);
    if(Touch0<=Touch0_Threshold) {
      Touch0_Flag=1;
      Serial.print("Touch1:1");
    }else {
      Touch0_Flag=0;
      Serial.print("Touch1:0");
    }
    if(Touch1<=Touch1_Threshold) {
      Touch1_Flag=1;
      Serial.println(" Touch2:1");
      Serial.println("");
    }else {
      Touch1_Flag=0;
      Serial.println(" Touch2:0");
      Serial.println("");
    }

    delay(500);
  }

  txData();
}
